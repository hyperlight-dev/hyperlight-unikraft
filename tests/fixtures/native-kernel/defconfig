## tests/fixtures/native-kernel/defconfig
```kconfig
CONFIG_UK_NAME="helloworld-native"
CONFIG_PLAT_HYPERLIGHT=y
CONFIG_LIBUKPAGING=y
CONFIG_LIBUKFALLOC=y
CONFIG_LIBUKVMEM=y
CONFIG_LIBUKVMEM_DEFAULT_BASE=0x0000001000000000
CONFIG_LIBUKVMEM_DEMAND_PAGE_IN_SIZE=12
CONFIG_LIBUKVMEM_PAGEFAULT_HANDLER_PRIO=4
CONFIG_LIBPOSIX_MMAP=y
CONFIG_LIBPOSIX_ENVIRON=y
CONFIG_LIBUKBOOT_HEAP_BASE=0x400000000
CONFIG_LIBUKBOOT_BANNER_NONE=y
CONFIG_LIBUKLIBID_INFO_COMPILEDATE=n
```
